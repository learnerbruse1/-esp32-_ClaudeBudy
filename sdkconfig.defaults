## sdkconfig.defaults
```kconfig
# ================================================================
# 学而思小喵掌机 统一固件 — 默认配置
# 目标: ESP32-D0WD (WROVER, Quad PSRAM, 4MB)
# ================================================================

# --- 目标芯片 ---
CONFIG_IDF_TARGET="esp32"

# --- 分区表 (自定义) ---
CONFIG_PARTITION_TABLE_CUSTOM=y
CONFIG_PARTITION_TABLE_CUSTOM_FILENAME="partitions.csv"
CONFIG_PARTITION_TABLE_OFFSET=0x8000

# --- Flash: 4MB / DIO / 40MHz (与本板一致) ---
CONFIG_ESPTOOLPY_FLASHSIZE_4MB=y
CONFIG_ESPTOOLPY_FLASHMODE_DIO=y
CONFIG_ESPTOOLPY_FLASHFREQ_40M=y

# --- PSRAM: ESP32 WROVER 为 Quad(四线) PSRAM, 40MHz(rev1 稳妥) ---
CONFIG_SPIRAM=y
CONFIG_SPIRAM_MODE_QUAD=y
CONFIG_SPIRAM_TYPE_AUTO=y
CONFIG_SPIRAM_SPEED_40M=y
CONFIG_SPIRAM_BOOT_INIT=y
CONFIG_SPIRAM_USE_MALLOC=y
CONFIG_SPIRAM_MALLOC_ALWAYSINTERNAL=16384
CONFIG_SPIRAM_TRY_ALLOCATE_WIFI_LWIP=y

# --- CPU 240MHz ---
CONFIG_ESP_DEFAULT_CPU_FREQ_MHZ_240=y

# --- FreeRTOS / 任务栈 ---
CONFIG_FREERTOS_HZ=1000
CONFIG_ESP_MAIN_TASK_STACK_SIZE=8192
CONFIG_ESP_SYSTEM_EVENT_TASK_STACK_SIZE=4096

# --- 编译优化 ---
CONFIG_COMPILER_OPTIMIZATION_PERF=y

# --- Bootloader (简化: 无 OTA, 直接进 factory) ---
CONFIG_BOOTLOADER_LOG_LEVEL_WARN=y
CONFIG_LOG_DEFAULT_LEVEL_INFO=y

# --- Wi-Fi 开启 (Claude Buddy 需要联网 + SoftAP 配网) ---
CONFIG_ESP_WIFI_ENABLED=y

# --- HTTP(S) 客户端 + TLS 证书包 (用于访问 Anthropic / 中转 API) ---
CONFIG_ESP_TLS_USING_MBEDTLS=y
CONFIG_MBEDTLS_CERTIFICATE_BUNDLE=y
CONFIG_MBEDTLS_CERTIFICATE_BUNDLE_DEFAULT_FULL=y
CONFIG_MBEDTLS_DYNAMIC_BUFFER=y
CONFIG_MBEDTLS_SSL_VARIABLE_BUFFER_LENGTH=y

# --- HTTP 服务器 (SoftAP 配网门户 + 可选手机网页输入) ---
CONFIG_HTTPD_MAX_REQ_HDR_LEN=1024
CONFIG_HTTPD_MAX_URI_LEN=512

# --- LVGL: 16 位色 ---
CONFIG_LV_COLOR_DEPTH_16=y
CONFIG_LV_USE_PERF_MONITOR=n
# 投屏需要 lv_snapshot 抓屏
CONFIG_LV_USE_SNAPSHOT=y
```

## xueersi2/学而思小喵编程掌机/_research/gomoku/sdkconfig.defaults
```kconfig
# ESP32-WROVER-B settings for XRS Gomoku (五子棋)
# Flash: 4MB, PSRAM: 8MB (Octal)

# Partition table - single factory app, no OTA
CONFIG_PARTITION_TABLE_SINGLE_APP=y

# SPI RAM (PSRAM) — WROVER-B has 8MB Octal PSRAM
CONFIG_SPIRAM=y
CONFIG_SPIRAM_MODE_OCT=y
CONFIG_SPIRAM_SPEED_80M=y
CONFIG_SPIRAM_BOOT_INIT=y

# Flash size: 4MB
CONFIG_ESPTOOLPY_FLASHSIZE_4MB=y

# Flash SPI mode: DIO (safe default)
CONFIG_ESPTOOLPY_FLASHMODE_DIO=y

# Flash frequency: 40MHz (safe default)
CONFIG_ESPTOOLPY_FLASHFREQ_40M=y

# CPU frequency: 240MHz (max for ESP32)
CONFIG_ESP_DEFAULT_CPU_FREQ_MHZ_240=y

# FreeRTOS tick rate: 1000Hz (needed for smooth LVGL timers)
CONFIG_FREERTOS_HZ=1000

# Main task stack size: 8KB
CONFIG_ESP_MAIN_TASK_STACK_SIZE=8192

# Compiler optimization: performance (-O2)
CONFIG_COMPILER_OPTIMIZATION_PERF=y

# IRAM optimization — keep critical code in IRAM for speed
CONFIG_SPIRAM_FETCH_INSTRUCTIONS=y
CONFIG_SPIRAM_RODATA=y

# Increase event loop task stack for LVGL
CONFIG_ESP_SYSTEM_EVENT_TASK_STACK_SIZE=4096

# Disable WiFi/Bluetooth (not needed for Gomoku)
CONFIG_ESP_WIFI_ENABLED=n
CONFIG_ESP_WIFI_REMOTE_ENABLED=n
CONFIG_BT_ENABLED=n
```
